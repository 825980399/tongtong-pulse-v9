## hardware/robot_body/servo_controller/sdkconfig.defaults
```kconfig
# 芯片目标
CONFIG_IDF_TARGET="esp32p4"
CONFIG_ESP32P4_DEFAULT_CPU_FREQ_360=y

# 16MB Octal PSRAM配置
CONFIG_SPIRAM_SUPPORT=y
CONFIG_SPIRAM_MODE_OCT=y
CONFIG_SPIRAM_CLK_200M=y
CONFIG_SPIRAM_SIZE_16MB=y

# FreeRTOS系统配置
CONFIG_FREERTOS_HZ=1000
CONFIG_MAIN_TASK_STACK_SIZE=10240

# 日志与串口
CONFIG_CONSOLE_UART_DEFAULT=y
CONFIG_LOG_DEFAULT_LEVEL_INFO=y

# 网络TCP支持
CONFIG_LWIP_TCP=y
```
